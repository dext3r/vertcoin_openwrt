## vertcoin/Config.in
```kconfig
config VERTCOIN
	bool "Enable Vertcoin"
	default y 

config VERTCOIN_ENABLE_WALLET
	bool "Enable wallet"
	default n

config VERTCOIN_ENABLE_ZMQ
	bool "Enable ZMQ messaging"
	default n

config VERTCOIN_ENABLE_UPNP
	bool "Enable UPnP support"
	default n

config VERTCOIN_ALT_INSTALL
	bool "Install in alternate location"
	default n

config VERTCOIN_ALT_INSTALL_DIR
	depends VERTCOIN_ALT_INSTALL	
	string "Install location"

config VERTCOIN_COPY_BLOCK_DB
	depends VERTCOIN_ALT_INSTALL
	bool "Copy existing Block DB"
	default n

config VERTCOIN_COPY_BLOCK_DB_DIR
	depends VERTCOIN_COPY_BLOCK_DB
	string "Database location"
```
